## firmware/esp32s3-gateway/sdkconfig.defaults
```kconfig
CONFIG_ESP_WIFI_ENABLED=y
CONFIG_ESP_WIFI_ESPNOW_MAX_ENCRYPT_NUM=7
CONFIG_ESP_CONSOLE_UART_DEFAULT=y
# Free USB Serial/JTAG for telemetry (edge-gateway reads /dev/cu.usbmodem*)
CONFIG_ESP_CONSOLE_SECONDARY_NONE=y
```
